## west.yml
```yaml
manifest:
  self:
    path: ble-mesh-atmospheric-sensor

  remotes:
    - name: zephyrproject-rtos
      url-base: git@github.com:zephyrproject-rtos

  projects:
    - name: zephyr
      remote: zephyrproject-rtos
      revision: zephyr-v3.2.0
      import: true
```
